;
; xv65.inc
;

;
; Copyright (C) 2012-2013  Emanuele Fornara
; All rights reserved.
;
; Redistribution and use in source and binary forms, with or without
; modification, are permitted provided that the following conditions
; are met:
;  * Redistributions of source code must retain the above copyright
;    notice, this list of conditions and the following disclaimer.
;  * Redistributions in binary form must reproduce the above copyright
;    notice, this list of conditions and the following disclaimer in
;    the documentation and/or other materials provided with the
;    distribution.
;
; THIS SOFTWARE IS PROVIDED BY THE COPYRIGHT HOLDERS AND CONTRIBUTORS
; "AS IS" AND ANY EXPRESS OR IMPLIED WARRANTIES, INCLUDING, BUT NOT
; LIMITED TO, THE IMPLIED WARRANTIES OF MERCHANTABILITY AND FITNESS
; FOR A PARTICULAR PURPOSE ARE DISCLAIMED. IN NO EVENT SHALL THE
; COPYRIGHT OWNER OR CONTRIBUTORS BE LIABLE FOR ANY DIRECT, INDIRECT,
; INCIDENTAL, SPECIAL, EXEMPLARY, OR CONSEQUENTIAL DAMAGES (INCLUDING,
; BUT NOT LIMITED TO, PROCUREMENT OF SUBSTITUTE GOODS OR SERVICES; LOSS
; OF USE, DATA, OR PROFITS; OR BUSINESS INTERRUPTION) HOWEVER CAUSED
; AND ON ANY THEORY OF LIABILITY, WHETHER IN CONTRACT, STRICT LIABILITY,
; OR TORT (INCLUDING NEGLIGENCE OR OTHERWISE) ARISING IN ANY WAY OUT
; OF THE USE OF THIS SOFTWARE, EVEN IF ADVISED OF THE POSSIBILITY OF
; SUCH DAMAGE.
;

PUTCHAR = $0200

REQPUT = $0201
REQEND = $0202
REQRES = $0203

REQPTRLO = $0204
REQPTRHI = $0205

FRMFPS = $0211
FRMDRAW = $0212
RANDOM = $0217

CONCOLS = $0220
CONROWS = $0221
CONESC = $0227

REQERRNO = $0250
PIDSIZE = $0251
DBGLEVEL = $0252
ERREXIT = $0253

REQDAT = $0260
REQDAT2 = $0268

REQ_FORK   =  1
REQ_EXIT   =  2
REQ_WAIT   =  3
REQ_PIPE   =  4
REQ_READ   =  5
REQ_KILL   =  6
REQ_EXEC   =  7
REQ_FSTAT  =  8
REQ_CHDIR  =  9
REQ_DUP    = 10
REQ_GETPID = 11
REQ_SBRK   = 12
REQ_SLEEP  = 13
REQ_UPTIME = 14
REQ_OPEN   = 15
REQ_WRITE  = 16
REQ_MKNOD  = 17
REQ_UNLINK = 18
REQ_LINK   = 19
REQ_MKDIR  = 20
REQ_CLOSE  = 21

REQ_ARGC   = 32
REQ_ARGV   = 33
REQ_ENV    = 34
REQ_TIME   = 35

ESC_HOME       =   1
ESC_CLEAR      =   2
ESC_NORMAL     =   3

ESC_FG_BLACK   =  30
ESC_FG_RED     =  31
ESC_FG_GREEN   =  32
ESC_FG_YELLOW  =  33
ESC_FG_BLUE    =  34
ESC_FG_MAGENTA =  35
ESC_FG_CYAN    =  36
ESC_FG_WHITE   =  37

ESC_BG_BLACK   =  40
ESC_BG_RED     =  41
ESC_BG_GREEN   =  42
ESC_BG_YELLOW  =  43
ESC_BG_BLUE    =  44
ESC_BG_MAGENTA =  45
ESC_BG_CYAN    =  46
ESC_BG_WHITE   =  47

; STANDARD SYMBOLS

SIGHUP   = 1
SIGINT   = 2
SIGQUIT  = 3
SIGILL   = 4
SIGABRT  = 6
SIGFPE   = 8
SIGKILL  = 9
SIGSEGV = 11
SIGPIPE = 13
SIGALRM = 14
SIGTERM = 15

EPERM   =  1
ENOENT  =  2
ESRCH   =  3
EINTR   =  4
EIO     =  5
ENXIO   =  6
E2BIG   =  7
ENOEXEC =  8
EBADF   =  9
ECHILD  = 10
EAGAIN  = 11
ENOMEM  = 12
EACCES  = 13
EFAULT  = 14
ENOTBLK = 15
EBUSY   = 16
EEXIST  = 17
EXDEV   = 18
ENODEV  = 19
ENOTDIR = 20
EISDIR  = 21
EINVAL  = 22
ENFILE  = 23
EMFILE  = 24
ENOTTY  = 25
ETXTBSY = 26
EFBIG   = 27
ENOSPC  = 28
ESPIPE  = 29
EROFS   = 30
EMLINK  = 31
EPIPE   = 32
EDOM    = 33
ERANGE  = 34

O_RDONLY   =  0
O_WRONLY   =  1
O_RDWR     =  2
O_CREAT    = 64

; ASM ONLY

IO = $0200

.macro  req
@_req_: .word @_endreq_ - @_req_ - 2
.endmacro

.macro  endreq
@_endreq_:
.endmacro
