;
; jbfmt.inc
;

;
; Copyright (C) 2012-2017  Emanuele Fornara
; All rights reserved.
;
; Redistribution and use in source and binary forms, with or without
; modification, are permitted provided that the following conditions
; are met:
;  * Redistributions of source code must retain the above copyright
;    notice, this list of conditions and the following disclaimer.
;  * Redistributions in binary form must reproduce the above copyright
;    notice, this list of conditions and the following disclaimer in
;    the documentation and/or other materials provided with the
;    distribution.
;
; THIS SOFTWARE IS PROVIDED BY THE COPYRIGHT HOLDERS AND CONTRIBUTORS
; "AS IS" AND ANY EXPRESS OR IMPLIED WARRANTIES, INCLUDING, BUT NOT
; LIMITED TO, THE IMPLIED WARRANTIES OF MERCHANTABILITY AND FITNESS
; FOR A PARTICULAR PURPOSE ARE DISCLAIMED. IN NO EVENT SHALL THE
; COPYRIGHT OWNER OR CONTRIBUTORS BE LIABLE FOR ANY DIRECT, INDIRECT,
; INCIDENTAL, SPECIAL, EXEMPLARY, OR CONSEQUENTIAL DAMAGES (INCLUDING,
; BUT NOT LIMITED TO, PROCUREMENT OF SUBSTITUTE GOODS OR SERVICES; LOSS
; OF USE, DATA, OR PROFITS; OR BUSINESS INTERRUPTION) HOWEVER CAUSED
; AND ON ANY THEORY OF LIABILITY, WHETHER IN CONTRACT, STRICT LIABILITY,
; OR TORT (INCLUDING NEGLIGENCE OR OTHERWISE) ARISING IN ANY WAY OUT
; OF THE USE OF THIS SOFTWARE, EVEN IF ADVISED OF THE POSSIBILITY OF
; SUCH DAMAGE.
;

JBFMT_SIZE_HEADER = $0C

JBFMT_OFFSET_SIGNATURE = $00
JBFMT_OFFSET_HEADERLENGTH = $04
JBFMT_OFFSET_VERSION = $06
JBFMT_OFFSET_CODEPAGES = $08
JBFMT_OFFSET_DATAPAGES = $09
JBFMT_OFFSET_DEVID = $0A

JBFMT_SIGNATURE_0 = $4A
JBFMT_SIGNATURE_1 = $42
JBFMT_SIGNATURE_2 = $69
JBFMT_SIGNATURE_3 = $74

JBFMT_VERSION_0_MAJOR = $01
JBFMT_VERSION_1_MINOR = $00

JBFMT_DEVID_UNSPEC = $00
JBFMT_DEVID_STDOUT = $01
JBFMT_DEVID_XV65 = $02
JBFMT_DEVID_MICROIO = $03
JBFMT_DEVID_IO2 = $04
