;
; io2.inc
;

;
; Copyright (C) 2012-2016  Emanuele Fornara
; All rights reserved.
;
; Redistribution and use in source and binary forms, with or without
; modification, are permitted provided that the following conditions
; are met:
;  * Redistributions of source code must retain the above copyright
;    notice, this list of conditions and the following disclaimer.
;  * Redistributions in binary form must reproduce the above copyright
;    notice, this list of conditions and the following disclaimer in
;    the documentation and/or other materials provided with the
;    distribution.
;
; THIS SOFTWARE IS PROVIDED BY THE COPYRIGHT HOLDERS AND CONTRIBUTORS
; "AS IS" AND ANY EXPRESS OR IMPLIED WARRANTIES, INCLUDING, BUT NOT
; LIMITED TO, THE IMPLIED WARRANTIES OF MERCHANTABILITY AND FITNESS
; FOR A PARTICULAR PURPOSE ARE DISCLAIMED. IN NO EVENT SHALL THE
; COPYRIGHT OWNER OR CONTRIBUTORS BE LIABLE FOR ANY DIRECT, INDIRECT,
; INCIDENTAL, SPECIAL, EXEMPLARY, OR CONSEQUENTIAL DAMAGES (INCLUDING,
; BUT NOT LIMITED TO, PROCUREMENT OF SUBSTITUTE GOODS OR SERVICES; LOSS
; OF USE, DATA, OR PROFITS; OR BUSINESS INTERRUPTION) HOWEVER CAUSED
; AND ON ANY THEORY OF LIABILITY, WHETHER IN CONTRACT, STRICT LIABILITY,
; OR TORT (INCLUDING NEGLIGENCE OR OTHERWISE) ARISING IN ANY WAY OUT
; OF THE USE OF THIS SOFTWARE, EVEN IF ADVISED OF THE POSSIBILITY OF
; SUCH DAMAGE.
;

REQPUT = $0201
REQEND = $0202
REQRES = $0203
REQPTRLO = $0204
REQPTRHI = $0205
ENABLE = $0210
FRMFPS = $0211
FRMDRAW = $0212
GKEY0 = $0213
GKEY1 = $0214
RANDOM = $0217
KEYBUF = $0218
CONCOLS = $0220
CONROWS = $0221
CONCX = $0222
CONCY = $0223
CONCCHR = $0224
CONCFG = $0225
CONCBG = $0226
CONVIDEO = $0228
CONROW0 = $0228
CONROW1 = $0232
CONROW2 = $023C
CONROW3 = $0246
LID = $0250
LCTL = $0251
LX = $0252
LY = $0253
SFRAME = $0254
STRANSFM = $0255
SCWITH = $0256
TCOLLO = $0257
TCOLHI = $0258
TROWLO = $0259
TROWHI = $025A
TCELL = $025B
REQDAT = $0260
REQ_NOREQ = $00
REQ_TIME = $02
REQ_LOADROM = $06
REQ_RSFORMAT = $08
REQ_RLOAD = $09
REQ_RSAVE = $0A
REQ_RDELETE = $0B
REQ_DPYINFO = $10
REQ_SETBGCOL = $11
REQ_SETPAL = $12
REQ_SETBGIMG = $13
REQ_IDESTROY = $14
REQ_IDIM = $15
REQ_IINFO = $16
REQ_ILOAD = $17
REQ_IDUMMY = $18
REQ_IPNGGEN = $19
REQ_IEMPTY = $1A
REQ_IMKIMMUT = $1B
REQ_IRAWRGBA = $1C
REQ_LMVIEW = $20
REQ_LMPOS = $21
REQ_LDESTROY = $22
REQ_LDIM = $23
REQ_LTILED = $24
REQ_LSPRITE = $25
REQ_LSETPOS = $26
REQ_LGETPOS = $27
REQ_LMOVE = $28
REQ_LSETPRI = $29
REQ_LGETPRI = $2A
REQ_LTLANIM = $2B
REQ_LTLFILL = $2C
REQ_LTLPUT = $2D
REQ_LTLSCRLL = $2E
REQ_LSPCOPY = $2F
REQ_LSPAPOS = $30
REQ_LSPREFPX = $31
REQ_LSPCLRCT = $32
REQ_GAMESET = $3C
REQ_FXTONE = $40
REQ_FXVIBRA = $41
REQ_FXFLASH = $42
ENABLE_BGCOL = $01
ENABLE_BGIMG = $02
ENABLE_CONSOLE = $04
ENABLE_LAYERS = $08
TIME_ABS = $01
TIME_RESET = $02
TIME_1 = $01
TIME_10 = $02
TIME_100 = $03
TIME_1000 = $04
DPYINFO_WIDTH = $00
DPYINFO_HEIGHT = $02
DPYINFO_COLORDEPTH = $04
DPYINFO_ALPHADEPTH = $05
DPYINFO_FLAGS = $06
DPYINFO_FLAGS_ISCOLOR = $80
DPYINFO_FLAGS_ISMIDP2 = $40
DPYINFO_FLAGS_ISTOUCH = $20
SETPAL_STD = $00
SETPAL_RGB = $01
IINFO_WIDTH = $00
IINFO_HEIGHT = $02
IINFO_FLAGS = $04
IINFO_FLAGS_ISMUTABLE = $80
IDUMMY_SIMPLE = $01
IDUMMY_SPRITE = $02
IDUMMY_TILES = $03
IPNGGEN_CT_GRAYSCALE = $00
IPNGGEN_CT_TRUECOLOR = $02
IPNGGEN_CT_INDEXED_COLOR = $03
IPNGGEN_CT_GRAYSCALE_ALPHA = $04
IPNGGEN_CT_TRUECOLOR_ALPHA = $06
IPNGGEN_FLAGS_IDX0TRANSP = $01
IPNGGEN_FLAGS_PALREF = $02
IPNGGEN_FLAGS_ZOOM0 = $04
IPNGGEN_FLAGS_ZOOM1 = $08
IRAWRGBA_FLAGS_ALPHA = $01
DATATYPE_U8 = $01
DATATYPE_I8 = $02
DATATYPE_U16 = $03
DATATYPE_I16 = $04
LCTL_SHIFTX0 = $01
LCTL_SHIFTX1 = $02
LCTL_SHIFTY0 = $04
LCTL_SHIFTY1 = $08
LCTL_PXLCOLL = $40
LCTL_ENABLE = $80
LCTL_SHIFTX_MASK = $03
LCTL_SHIFTY_MASK = $0C
LTRANSFM_NONE = $00
LTRANSFM_ROT90 = $05
LTRANSFM_ROT180 = $03
LTRANSFM_ROT270 = $06
LTRANSFM_MIRROR = $02
LTRANSFM_MIRROR_ROT90 = $07
LTRANSFM_MIRROR_ROT180 = $01
LTRANSFM_MIRROR_ROT270 = $04
GKEY0_UP = $02
GKEY0_LEFT = $04
GKEY0_RIGHT = $20
GKEY0_DOWN = $40
GKEY1_FIRE = $01
GKEY1_A = $02
GKEY1_B = $04
GKEY1_C = $08
GKEY1_D = $10
GAMESET_COLS = $00
GAMESET_ROWS = $02
TILESET_SILK = $FF
TILESET_FONT = $FE
ALINE_TOP = $01
ALINE_LEFT = $02
ALINE_RIGHT = $04
ALINE_BOTTOM = $08
COLOR_BLACK = $00
COLOR_WHITE = $01
COLOR_RED = $02
COLOR_CYAN = $03
COLOR_VIOLET = $04
COLOR_PURPLE = $04
COLOR_GREEN = $05
COLOR_BLUE = $06
COLOR_YELLOW = $07
COLOR_ORANGE = $08
COLOR_BROWN = $09
COLOR_LIGHTRED = $0A
COLOR_GRAY1 = $0B
COLOR_GRAY2 = $0C
COLOR_LIGHTGREEN = $0D
COLOR_LIGHTBLUE = $0E
COLOR_GRAY3 = $0F
CH_ULCORNER = $8C
CH_URCORNER = $8A
CH_LLCORNER = $85
CH_LRCORNER = $83
CH_HLINE = $86
CH_VLINE = $89
CH_TTEE = $8E
CH_RTEE = $89
CH_BTEE = $8B
CH_LTEE = $8D
CH_CROSS = $8F

; ASM ONLY

IO = $0200

.macro	req
@_req_: .word @_endreq_ - @_req_ - 2
.endmacro

.macro	endreq
@_endreq_:
.endmacro
